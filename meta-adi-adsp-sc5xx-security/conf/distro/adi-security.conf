## meta-adi-adsp-sc5xx-security/conf/distro/adi-security.conf
```bitbake
require conf/distro/adi-distro-glibc.conf

DISTRO = "adi-security"

DISTRO_FEATURES:append = " optee"
DISTRO_FEATURES:append = " signedboot"

LTO:pn-optee-os = ""
LTO:pn-optee-client = ""
LTO:pn-optee-test = ""
LTO:pn-libadiotp = ""
LTO:pn-libopteesharc = ""
LTO:pn-optee-examples = ""

# adsp-signed-boot will automatically use optee-os; optee-test will include
# the optee-os-dev package as necessary
DISTRO_EXTRA_RDEPENDS = "adsp-signed-boot optee-client optee-test libadiotp libopteesharc optee-examples"

# This is the actual load address less 0x1c to account for the optee header
OPTEE_LOAD_ADDRESS ?= "0x9eefffe4"

require conf/distro/include/adsp-sc5xx-security.inc
```
